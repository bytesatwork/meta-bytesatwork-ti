## conf/layer.conf
```bitbake
# Copyright (C) 2014 Oliver Stäbler <oliver.staebler@bytesatwork.ch>
# Released under the MIT license (see COPYING.MIT for the terms)

# We have a conf and classes directory, add to BBPATH
BBPATH =. "${LAYERDIR}:"

# We have recipes-* directories, add to BBFILES
BBFILES += "${LAYERDIR}/recipes-*/*/*.bb \
            ${LAYERDIR}/recipes-*/*/*.bbappend"

BBFILE_COLLECTIONS += "meta-bytesatwork-ti"
BBFILE_PATTERN_meta-bytesatwork-ti = "^${LAYERDIR}/"
BBFILE_PRIORITY_meta-bytesatwork-ti = "8"

LAYERDEPENDS_meta-bytesatwork-ti = " \
	meta-ti \
"

LAYERSERIES_COMPAT_meta-bytesatwork-ti = "thud"

IMAGE_CLASSES += "sdcard_image-bytesatwork"
```

## conf/machine/bytedevkit-am335x.conf
```bitbake
# Copyright (C) 2014-2017 Oliver Stäbler <oliver.staebler@bytesatwork.ch>
# Released under the MIT license (see COPYING.MIT for the terms)

#@TYPE: Machine
#@NAME: byteDEVKIT am335x (eMMC)
#@DESCRIPTION: byteDEVKIT am335x (eMMC) by bytes at work AG

require conf/machine/include/ti33x.inc
require include/byteengine-ti.inc

UBOOT_MACHINE = "am335x_bytedevkit_defconfig"

KERNEL_DEVICETREE_bytedevkit-am335x = "am335x-bytedevkit.dtb"
KERNEL_DEFCONFIG = "multi_v7_defconfig"

IMAGE_BOOT_FILES += "am335x-bytedevkit.dtb;devtree.dtb"
```

## conf/machine/bytedevkit-am62x-k3r5.conf
```bitbake
#@TYPE: Machine
#@NAME: byteDEVKIT AM62x (R5F)
#@DESCRIPTION: byteDEVKIT AM62x (R5F core) by bytes at work AG

require conf/machine/include/k3r5.inc
require conf/machine/include/ti-extras.inc

SYSFW_SOC = "am62x"
SYSFW_CONFIG = "bytedevkit"
SYSFW_SUFFIX = "gp"

UBOOT_MACHINE = "am62x_bytedevkit_r5_defconfig"
```

## conf/machine/bytepanel-emmc.conf
```bitbake
# Copyright (C) 2014-2017 Oliver Stäbler <oliver.staebler@bytesatwork.ch>
# Released under the MIT license (see COPYING.MIT for the terms)

#@TYPE: Machine
#@NAME: bytePANEL eMMC
#@DESCRIPTION: bytePANEL eMMC by bytes at work AG

require conf/machine/include/ti33x.inc
require include/byteengine-ti.inc

UBOOT_MACHINE = "am335x_bytedevkit_emmc_defconfig"

KERNEL_DEVICETREE_bytepanel-emmc = "bytepanel-emmc.dtb"
KERNEL_DEFCONFIG = "bytepanel_defconfig"

MACHINE_FEATURES += "touchscreen"

IMAGE_BOOT_FILES += "bytepanel-emmc.dtb;devtree.dtb"
```

## conf/machine/include/byteengine-ti.inc
```bitbake
# Copyright (C) 2014-2016 Oliver Stäbler <oliver.staebler@bytesatwork.ch>
# Released under the MIT license (see COPYING.MIT for the terms)

#@TYPE: Machine
#@NAME: byteENGINE
#@DESCRIPTION: byteENGINE by bytes at work AG

SERIAL_CONSOLES = "115200;ttyO0"
IMAGE_FSTYPES = "tar.bz2 wic.bmap wic.gz"

KERNEL_IMAGETYPE = "uImage"
PREFERRED_PROVIDER_virtual/kernel = "linux-ti-staging"
PREFERRED_PROVIDER_virtual/bootloader = "u-boot-ti-staging"
PREFERRED_VERSION_linux-ti-staging = "4.19%"
PREFERRED_VERSION_u-boot-ti-staging = "2019.01%"

WKS_FILE = "beaglebone-yocto.wks"
do_image_wic[depends] += "mtools-native:do_populate_sysroot dosfstools-native:do_populate_sysroot u-boot:do_deploy"
IMAGE_BOOT_FILES = "u-boot.${UBOOT_SUFFIX} MLO ${KERNEL_IMAGETYPE} ${KERNEL_DEVICETREE}"
```

## wic/am62x-sd.wks
```
# short-description: SD card image for AM62x

part /boot --source bootimg-partition --ondisk mmcblk0 --fstype=vfat --label boot --align 1024 --active --fixed-size 128M --fsoptions "defaults,noauto"
part / --source rootfs --ondisk mmcblk0 --fstype=ext4 --label rootfs --align 1024
```

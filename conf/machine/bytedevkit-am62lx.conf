## conf/machine/bytedevkit-am62lx.conf
```bitbake
#@TYPE: Machine
#@NAME: byteDEVKIT AM62L
#@DESCRIPTION: byteDEVKIT OSM-S AM62L by bytesatwork AG

require conf/machine/include/am62lxx.inc

UBOOT_MACHINE = "am62lx_bytedevkit_defconfig"

#FIT_CONF_DEFAULT_DTB = "k3-am62l3-evm.dtb"

KERNEL_DEVICETREE_PREFIX = " \
    ti/k3-am62l3 \
    ti/k3-am62lx-bytedevkit \
"

KERNEL_DEVICETREE = " \
    ti/k3-am62l3-bytedevkit-v2-0.dtb \
"

KERNEL_CONFIG_FRAGMENTS = ""
KERNEL_DEFCONFIG_INTREE = "bytedevkit_am62lx_defconfig"
KERNEL_DEVICETREE_INTREE = " \
	k3-am62l3-bytedevkit-v2-0.dtb \
"

UBOOT_MACHINE = "am62lx_bytedevkit_defconfig"

WKS_FILE = "am62x-sd.wks"

# The AM62L boots via TI bootloader/U-Boot and does not use an EFI bootloader.
WKS_FILE_DEPENDS:remove = "grub-efi systemd-boot"

IMAGE_FSTYPES += "tar.gz wic.gz wic.bmap"
IMAGE_FSTYPES:remove = "tar.xz wic.xz"
IMAGE_INSTALL += "ti-rtos-echo-test-fw"
IMAGE_INSTALL += "kernel"

MACHINE_FEATURES:remove = "efi"
EFI_PROVIDER = ""

SERIAL_CONSOLES = "115200;ttyS0"
```

## conf/machine/bytedevkit-am62x.conf
```bitbake
#@TYPE: Machine
#@NAME: byteDEVKIT AM62x
#@DESCRIPTION: byteDEVKIT AM62x by bytesatwork AG

require conf/machine/include/byteengine-am62xx.inc
require conf/machine/include/ti-extras.inc

KERNEL_DEVICETREE_PREFIX = " \
    ti/k3-am625 \
    ti/k3-am62x-bytedevkit \
"

KERNEL_DEVICETREE = " \
    ti/k3-am625-bytedevkit.dtb \
    ti/k3-am625-bytedevkit-2-2.dtb \
"

KERNEL_CONFIG_FRAGMENTS = ""
KERNEL_DEFCONFIG_INTREE = "bytedevkit_am62x_defconfig"
KERNEL_DEVICETREE_INTREE = " \
	k3-am625-bytedevkit.dtb \
	k3-am625-bytedevkit-2-2.dtb \
"

UBOOT_MACHINE = "am62x_bytedevkit_a53_defconfig"

WKS_FILE = "am62x-sd.wks"

IMAGE_FSTYPES += "tar.gz wic.gz wic.bmap"
IMAGE_FSTYPES:remove = "tar.xz wic.xz"
IMAGE_INSTALL += "ti-rtos-firmware"
IMAGE_INSTALL += "kernel"

MACHINE_FEATURES:remove = "efi"
EFI_PROVIDER = ""
```
